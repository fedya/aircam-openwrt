## build_dir/linux-gm812x/linux-2.6.28.fa2/arch/arm/mach-GM/Kconfig
```kconfig
#
# arch/arm/mach-GM/Kconfig
#

#
# GM Platform Types Selection
#
choice
	prompt "Platform Selection"
	default PLATFORM_GM8181
	depends on ARCH_GM

config PLATFORM_GM8181
	bool "GM8181 series platforms"
	select FIQ
	help
	  GM GM8181 is a platform based on GM's ARM9 compatible processor

config PLATFORM_GM8126
 	bool "GM8126 series platforms"
        select FIQ
        help
          GM GM8126 is a platform based on GM's ARM9 compatible processor
	
endchoice

config FORCE_MAX_ZONEORDER
    int
    depends on ARCH_GM
    default "12"
#
# Platform dependent options
#
menu "GM Platform Options"
	depends on ARCH_GM

source "arch/arm/mach-GM/platform-GM8181/Kconfig"
source "arch/arm/mach-GM/platform-GM8126/Kconfig"

endmenu
```

## build_dir/linux-gm812x/linux-2.6.28.fa2/arch/arm/mach-GM/platform-GM8126/Kconfig
```kconfig
#
# arch/arm/mach-GM/platform-GM8126/Kconfig

if PLATFORM_GM8126

#config SYS_CLK
config CLOCK_TICK_RATE	
        int "AHB System Clock"
        default 240000000
        help
          Manual setting of AHB clock, must match the jumper setting on
          the board, or the system time won't be correctly calculated.
          Notice that even when AUTO_SYS_CLK is ON, this value is still
          required for adjusting minor time offsets. However, the influence
          should be within micro-second to nano-second scale.

config FTINTC010EX
	bool "FTINTC010EX supports 64 IRQs"
	default y

config MFIQ
        bool "Multiple FIQ support"
        help
           There is only one FIQ supported in the Kernel, select this option if
           you want to support multiple FIQs on the system. Please ensure your
           FIQ handler has super low latency to the system. The default max FIQ
           handlers is 2, it is configurable in mach-GM/include/mach/mfiq.h.

config SECOND_SPI_FLASH
	bool "Second SPI flash support in traditional way"
	help
	  Select this if you have second SPI flash on board.

config SECOND_SPI_FLASH_COMBINED
	bool "Combine the Second SPI flash into the first SPI flash"
	help
	  If you want to cheat Linux that you have a single SPI flash, which is
	  composed of two, make this option enabled.                                                             
endif
```

## build_dir/linux-gm812x/linux-2.6.28.fa2/arch/arm/mach-GM/platform-GM8181/Kconfig
```kconfig
#
# arch/arm/mach-GM/platform-GM8181/Kconfig

if PLATFORM_GM8181

#config SYS_CLK
config CLOCK_TICK_RATE	
        int "AHB System Clock"
        default 240000000
        help
          Manual setting of AHB clock, must match the jumper setting on
          the board, or the system time won't be correctly calculated.
          Notice that even when AUTO_SYS_CLK is ON, this value is still
          required for adjusting minor time offsets. However, the influence
          should be within micro-second to nano-second scale.

config FTINTC010EX
	bool "FTINTC010EX supports 64 IRQs"
	default y

config MFIQ
        bool "Multiple FIQ support"
        help
           There is only one FIQ supported in the Kernel, select this option if
           you want to support multiple FIQs on the system. Please ensure your
           FIQ handler has super low latency to the system. The default max FIQ
           handlers is 2, it is configurable in mach-GM/include/mach/mfiq.h.
                                                             
endif
```

## build_dir/linux-gm812x/linux-2.6.28.fa2/arch/arm/mach-faraday/platform-a320/Kconfig
```kconfig
#
# arch/arm/mach-faraday/platform-a320/Kconfig

config PLATFORM_FIA321
	bool "A321 daughter board support"
	depends on PLATFORM_A320
	help
	  //TODO: help on PLATFORM_FIA321

config FTPCI100
	bool "Faraday PCI100 Support"
	depends on PCI && PLATFORM_FIA321
	help
	  FTPCI100 bus driver

config CLOCK_TICK_RATE
	int "System timer tick rate"
	depends on PLATFORM_A320
	default 16588800
	help
	  The frequency of system clock.
	  This value is used for adjusting minor time offsets.
```

## build_dir/linux-gm812x/linux-2.6.28.fa2/arch/arm/mach-faraday/platform-a360/Kconfig
```kconfig
#
# arch/arm/mach-faraday/platform-a360/Kconfig

comment "Platform-A360 Kernel Setting"
	depends on PLATFORM_A360

config CLOCK_TICK_RATE
	int "System timer tick rate"
	depends on PLATFORM_A360
	default 135000000
	help
	  The frequency of system clock.
	  This value is used for adjusting minor time offsets.

config SYSC
	bool "FARADAY FTSCU System Control"
	depends on PLATFORM_A360
	default y
```

## build_dir/linux-gm812x/linux-2.6.28.fa2/arch/arm/mach-faraday/platform-axi/Kconfig
```kconfig
#
# arch/arm/mach-faraday/platform-axi/Kconfig

config CLOCK_TICK_RATE
	int "System timer tick rate"
	depends on PLATFORM_AXI
	default 18000000
	help
	  The frequency of system clock.
	  It is APB clock rate (AHB clock rate / 2) on AXI develop board
```

## build_dir/toolchain-arm_v5te_gcc-linaro_uClibc-0.9.32_eabi/linux-2.6.28.fa2/arch/arm/mach-faraday/Kconfig
```kconfig
#
# arch/arm/mach-faraday/Kconfig
#

#
# Faraday Platform Types Selection
#
choice
	prompt "Platform Selection"
	default PLATFORM_A320
	depends on ARCH_FARADAY

config PLATFORM_A320
	bool "A320 evaluation board"
	select FTINTC010
	select FTPMU010
	select FTTMR010

config PLATFORM_A360
	bool "A360 evaluation board"
	select FTINTC010EX
	select FTPMU010
	select FTSCU000
	select FTTMR010

config PLATFORM_A369
	bool "A369 evaluation board"
	select FTINTC010EX
	select FTPMU010
	select FTPWMTMR010
	select FTSCU010

config PLATFORM_AXI
	bool "AXI development board"
	select FTINTC010
	select FTTMR010

config PLATFORM_FMP626A320
	bool "A320 evaluation board with FMP626"
	select ARM_GIC
	select FTINTC010
	select FTPMU010
	select FTTMR010

endchoice

#
# Platform dependent options
#
menu "Faraday Platform Options"
	depends on ARCH_FARADAY

source "arch/arm/mach-faraday/platform-a320/Kconfig"
source "arch/arm/mach-faraday/platform-a360/Kconfig"
source "arch/arm/mach-faraday/platform-a369/Kconfig"
source "arch/arm/mach-faraday/platform-axi/Kconfig"
source "arch/arm/mach-faraday/platform-fmp626a320/Kconfig"

endmenu

config FTINTC010
	bool
	help
	   FTINTC010 interrupt controller

config FTINTC010EX
	bool
	select FTINTC010
	help
	   newer version of FTINTC010 interrupt controller which supports up to 64 IRQ

config FTPMU010
	bool
	help
	  Power Management Unit

config FTPWMTMR010
	bool
	help
	  FTPWMTMR010 timer

config FTSCU000
	bool
	help
	  System Controller

config FTSCU010
	bool
	help
	  System Controller

config FTTMR010
	bool
	help
	  FTTMR010 timer

config UART_CLK
	int "UART Clock"
	default 18432000
	help
	  If this options is changed, please also append "38400" to your
	  kernel command line, e.g.:
	  console=uart,shift,2,io,0xf9820000,38400

if FTSCU010
source arch/arm/mach-faraday/Kconfig.ftscu010
endif
```

## build_dir/toolchain-arm_v5te_gcc-linaro_uClibc-0.9.32_eabi/linux-2.6.28.fa2/arch/arm/mach-faraday/Kconfig.ftscu010
```kconfig
# This shit is used to handle the brain-dead pin mux design.

menu "FTSUC010 Pin MUX settings"

choice
	prompt "Function group EXTAHB"
	default FTSCU010_PINMUX_FGEXTAHB_EXTAHB

	config FTSCU010_PINMUX_FGEXTAHB_EXTAHB
		bool "Enable extend AHB"

	config FTSCU010_PINMUX_FGEXTAHB_PERIPHERALS
		bool "Enable peripherals that use pins of extend AHB"

endchoice

choice
	prompt "Function group SATA"
	default FTSCU010_PINMUX_FGSATA_EXTAHB

	config FTSCU010_PINMUX_FGSATA_EXTAHB
		bool "Enable extend AHB pins in FG_SATA"

	config FTSCU010_PINMUX_FGSATA_SATA
		bool "Enable SATA"

	config FTSCU010_PINMUX_FGSATA_EXTDMA
		bool "Enable EXTDMA[2..3]"

endchoice

choice
	prompt "Function group ISP"
	default FTSCU010_PINMUX_FGISP_EXTAHB

	config FTSCU010_PINMUX_FGISP_EXTAHB
		bool "Enable extend AHB pins in FG_ISP"

	config FTSCU010_PINMUX_FGISP_GPIO1
		bool "Enable GPIO1[4..31]"

	config FTSCU010_PINMUX_FGISP_ISP
		bool "Enable Image Signal Processor"

endchoice

choice
	prompt "Function group TS"
	default FTSCU010_PINMUX_FGTS_EXTAHB

	config FTSCU010_PINMUX_FGTS_EXTAHB
		bool "Enable extend AHB pins in FG_TS"

	config FTSCU010_PINMUX_FGTS_GPIO0
		bool "Enable GPIO0[20..29]"

	config FTSCU010_PINMUX_FGTS_TS
		bool "Enable Transport Stream"

endchoice

choice
	prompt "Function group LCD"
	default FTSCU010_PINMUX_FGLCD_LCD_MICE

	config FTSCU010_PINMUX_FGLCD_LCD
		bool "Enable LCD and SDC0"

	config FTSCU010_PINMUX_FGLCD_TV_MICE
		bool "Enable TV encoder interface, ICE of master CPU (FA626TE) and SDC0"

	config FTSCU010_PINMUX_FGLCD_LCD_MICE
		bool "Enable LCD and ICE of master CPU (FA626TE)"

endchoice

choice
	prompt "Function group EBI"
	default FTSCU010_PINMUX_FGEBI_EBI

	config FTSCU010_PINMUX_FGEBI_EBI
		bool "Enable NOR Flash and NAND Flash"

	config FTSCU010_PINMUX_FGEBI_IDE
		bool "Enable IDE and NAND Flash"

endchoice

choice
	prompt "Function group UART1"
	default FTSCU010_PINMUX_FGUART1_EXTAHB

	config FTSCU010_PINMUX_FGUART1_EXTAHB
		bool "Enable extend AHB pins in FG_UART1"

	config FTSCU010_PINMUX_FGUART1_GPIO0
		bool "Enable GPIO0[0..1]"

	config FTSCU010_PINMUX_FGUART1_UART1
		bool "Enable UART1 w/o RTS/CTS"

endchoice

choice
	prompt "Function group UART2"
	default FTSCU010_PINMUX_FGUART2_GPIO1

	config FTSCU010_PINMUX_FGUART2_GPIO1
		bool "Enable GPIO1[24..25]"

	config FTSCU010_PINMUX_FGUART2_PWM2
		bool "Enable PWM2"

	config FTSCU010_PINMUX_FGUART2_UART2
		bool "Enable UART2 w/o RTS/CTS pins"

endchoice

choice
	prompt "Function group UART3"
	default FTSCU010_PINMUX_FGUART3_GPIO1

	config FTSCU010_PINMUX_FGUART3_GPIO1
		bool "Enable GPIO1[26..27]"

	config FTSCU010_PINMUX_FGUART3_UART3
		bool "Enable UART3 w/o RTS/CTS pins"

endchoice

choice
	prompt "Function group SSP0"
	default FTSCU010_PINMUX_FGSSP0_SSP0

	config FTSCU010_PINMUX_FGSSP0_SSP0
		bool "Enable SSP0"

	config FTSCU010_PINMUX_FGSSP0_SATA
		bool "Enable SATA and <X_SSP1_AC_RSTn> of SSP1"

	config FTSCU010_PINMUX_FGSSP0_SICE
		bool "Enable ICE of slave CPU (FA606)"

endchoice

choice
	prompt "Function group SSP1"
	default FTSCU010_PINMUX_FGSSP1_GPIO1

	config FTSCU010_PINMUX_FGSSP1_GPIO1
		bool "Enable GPIO1[28..31]"

	config FTSCU010_PINMUX_FGSSP1_I2C1
		bool "Enable I2C1, LCD clock and PWM clock"

	config FTSCU010_PINMUX_FGSSP1_SSP1
		bool "Enable SSP1"

endchoice

choice
	prompt "Function group GMAC"
	default FTSCU010_PINMUX_FGGMAC_GMAC

	config FTSCU010_PINMUX_FGGMAC_GMAC
		bool "Enable GMAC"

	config FTSCU010_PINMUX_FGGMAC_MCP_ICE
		bool "Enable MCP ICE"

endchoice

choice
	prompt "Function group PWM0"
	default FTSCU010_PINMUX_FGPWM0_EXTAHB

	config FTSCU010_PINMUX_FGPWM0_EXTAHB
		bool "Enable extend AHB pins in FG_PWM0"

	config FTSCU010_PINMUX_FGPWM0_PWM0
		bool "Enable PWM0"

	config FTSCU010_PINMUX_FGPWM0_EXTDMA
		bool "Enable EXTDMA[4]"

endchoice

choice
	prompt "Function group PWM1"
	default FTSCU010_PINMUX_FGPWM1_EXTAHB

	config FTSCU010_PINMUX_FGPWM1_GPIO1
		bool "Enable GPIO1[0..1]"

	config FTSCU010_PINMUX_FGPWM1_PWM1
		bool "Enable PWM1"

	config FTSCU010_PINMUX_FGPWM1_EXTAHB
		bool "Enable extend AHB pins in FG_PWM1"

endchoice

choice
	prompt "Function group I2C1"
	default FTSCU010_PINMUX_FGI2C1_EXTAHB

	config FTSCU010_PINMUX_FGI2C1_EXTAHB
		bool "Enable extend AHB pins in FG_I2C1"

	config FTSCU010_PINMUX_FGI2C1_GPIO1
		bool "Enable GPIO1[2..3]"

	config FTSCU010_PINMUX_FGI2C1_I2C1
		bool "Enable I2C1"

endchoice

choice
	prompt "Function group GPIO0"
	default FTSCU010_PINMUX_FGGPIO0_EXTAHB

	config FTSCU010_PINMUX_FGGPIO0_EXTAHB
		bool "Enable extend AHB pins in FG_GPIO0"

	config FTSCU010_PINMUX_FGGPIO0_GPIO0
		bool "Enable GPIO0[2..3]"

	config FTSCU010_PINMUX_FGGPIO0_EXTDMA
		bool "Enable EXTDMA[1]"

endchoice

choice
	prompt "Function group KBC"
	default FTSCU010_PINMUX_FGKBC_EXTAHB

	config FTSCU010_PINMUX_FGKBC_EXTAHB
		bool "Enable extend AHB pins in FG_KBC"

	config FTSCU010_PINMUX_FGKBC_GPIO0
		bool "Enable GPIO0[4..19]"

	config FTSCU010_PINMUX_FGKBC_KBC
		bool "Enable keyboard controller"

endchoice

endmenu
```

## build_dir/toolchain-arm_v5te_gcc-linaro_uClibc-0.9.32_eabi/linux-2.6.28.fa2/arch/arm/mach-faraday/platform-a369/Kconfig
```kconfig
#
# arch/arm/mach-faraday/platform-a369/Kconfig

comment "Platform-A369 Kernel Setting"
	depends on PLATFORM_A369

config CLOCK_TICK_RATE
	int "System timer tick rate"
	depends on PLATFORM_A369
	default 66000000
	help
	  The frequency of system clock.
	  This value is used for adjusting minor time offsets.
```

## build_dir/toolchain-arm_v5te_gcc-linaro_uClibc-0.9.32_eabi/linux-2.6.28.fa2/arch/arm/mach-faraday/platform-fmp626a320/Kconfig
```kconfig
#
# arch/arm/mach-faraday/platform-a320/Kconfig

config CLOCK_TICK_RATE
	int "System timer tick rate"
	depends on PLATFORM_FMP626A320
	default 16588800
	help
	  The frequency of system clock.
	  This value is used for adjusting minor time offsets.
```

## build_dir/toolchain-arm_v5te_gcc-linaro_uClibc-0.9.32_eabi/linux-2.6.28.fa2/drivers/gpio/chips/gm/Kconfig
```kconfig
menu "Grain Media GPIO controller"
config GPIO_GM8181
        tristate "GM8181 GPIO controller"
        default y
        depends on PLATFORM_GM8181
        help
          Enable GM8181 GPIO controller's function

config GPIO_GM8126
        tristate "GM8126 GPIO controller"
        default y
        depends on PLATFORM_GM8126
        help
          Enable GM8126 GPIO controller's function
endmenu
```
